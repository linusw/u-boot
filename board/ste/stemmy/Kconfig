## board/ste/stemmy/Kconfig
```kconfig
if TARGET_STEMMY

config SYS_BOARD
	default "stemmy"

config SYS_VENDOR
	default "ste"

config SYS_CONFIG_NAME
	default "stemmy"

config DEFAULT_DEVICE_TREE
	default "st/ste-ux500-samsung-janice"

config OF_LIST
	default "st/ste-ux500-samsung-codina st/ste-ux500-samsung-codina-tmo st/ste-ux500-samsung-gavini st/ste-ux500-samsung-golden st/ste-ux500-samsung-janice st/ste-ux500-samsung-kyle st/ste-ux500-samsung-skomer"

endif
```
